## config/west.yml
```yaml
manifest:
  remotes:
    - name: zmkfirmware
      url-base: https://github.com/petejohanson
    - name: Enursha
      url-base: https://github.com/Enursha/zmk-pmw3320-driver
  projects:
    - name: zmk
      remote: zmkfirmware
      revision: feat/pointers-move-scroll
      import: app/west.yml
    - name: zmk-pmw3610-driver
      remote: Enursha
      revision: 3320
  self:
    path: config
```
